// dumpad_v1_1.dts
/dts-v1/;

/ {
    compatible = "zmk,keyboard-shield";

    matrix {
        compatible = "zmk,matrix-transform";
        row-gpios = <&gpio0 4 GPIO_ACTIVE_LOW>,    // F4
                    <&gpio0 5 GPIO_ACTIVE_LOW>,    // F5
                    <&gpio0 6 GPIO_ACTIVE_LOW>,    // F6
                    <&gpio0 7 GPIO_ACTIVE_LOW>;    // F7

        col-gpios = <&gpio0 6 GPIO_ACTIVE_LOW>,    // C6
                    <&gpio0 7 GPIO_ACTIVE_LOW>,    // D7
                    <&gpio1 6 GPIO_ACTIVE_LOW>,    // E6
                    <&gpio1 4 GPIO_ACTIVE_LOW>,    // B4
                    <&gpio1 5 GPIO_ACTIVE_LOW>;    // B5

        diode-direction = "col2row";
    };

    encoder {
        compatible = "zmk,behavior-rotary-encoder";
        label = "rotary_encoder";
        a-gpios = <&gpio1 2 GPIO_ACTIVE_LOW>; // B2
        b-gpios = <&gpio0 4 GPIO_ACTIVE_LOW>; // D4
    };
};
