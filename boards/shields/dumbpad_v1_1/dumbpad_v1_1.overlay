/ {
  kscan0: kscan {
    compatible = "zmk,kscan-gpio-matrix";
    label = "KSCAN";
    row-gpios = <&gpio0 4 GPIO_ACTIVE_LOW>,  // F4 → P0.04
                <&gpio0 5 GPIO_ACTIVE_LOW>,  // F5 → P0.05
                <&gpio0 6 GPIO_ACTIVE_LOW>,  // F6 → P0.06
                <&gpio0 7 GPIO_ACTIVE_LOW>;  // F7 → P0.07

    col-gpios = <&gpio0 14 GPIO_ACTIVE_LOW>, // B1 → P0.14
                <&gpio0 16 GPIO_ACTIVE_LOW>, // B3 → P0.16
                <&gpio0 15 GPIO_ACTIVE_LOW>, // B2 → P0.15
                <&gpio0 10 GPIO_ACTIVE_LOW>; // D6 → P0.10

    debounce-period-ms = <5>;
  };

  encoder0: encoder_0 {
    compatible = "zmk,rotary-encoder";
    gpios = <&gpio0 1 GPIO_ACTIVE_LOW>,  // D3 → P0.01 (A)
            <&gpio0 0 GPIO_ACTIVE_LOW>;  // D2 → P0.00 (B)
    encoder-events = <INPUT_ENCODER_0_CW INPUT_ENCODER_0_CCW>;
    steps = <4>;
  };

  encoder_button: encoder_button {
    compatible = "zmk,behavior-momentary-layer";
    label = "ENCODER_BTN";
    gpios = <&gpio0 2 GPIO_ACTIVE_LOW>; // D4 → P0.02 (SW)
    layer = <1>;
  };
};

